## vm/guest/Config.in
```kconfig
menu "Leftovers strict VM guest"

source "$BR2_EXTERNAL_LEFTOVERS_GUEST_PATH/package/leftovers-guest-supervisor/Config.in"

endmenu
```

## vm/guest/configs/leftovers_strict_vm_defconfig
```kconfig
# Generated artifacts are an initramfs and a separate read-only ext2 root image.
# This is a scaffolding defconfig; `vm/guest/README.md` describes the mandatory
# provenance, VM, and adversarial-test gates before any boot artifact is admitted.
BR2_aarch64=y
BR2_cortex_a76=y
BR2_TOOLCHAIN_BUILDROOT_MUSL=y
BR2_STATIC_LIBS=y
BR2_INIT_NONE=y
BR2_SYSTEM_DHCP=""
BR2_ROOTFS_DEVICE_CREATION_STATIC=y
BR2_LINUX_KERNEL=y
BR2_LINUX_KERNEL_CUSTOM_GIT=y
BR2_LINUX_KERNEL_CUSTOM_REPO_URL="https://git.kernel.org/pub/scm/linux/kernel/git/stable/linux.git"
BR2_LINUX_KERNEL_CUSTOM_REPO_VERSION="669dc96e243e422e7404bb98be00d527bafc0a96"
BR2_LINUX_KERNEL_USE_DEFCONFIG=y
BR2_LINUX_KERNEL_DEFCONFIG="defconfig"
BR2_LINUX_KERNEL_CONFIG_FRAGMENT_FILES="$(BR2_EXTERNAL_LEFTOVERS_GUEST_PATH)/board/leftovers/linux.fragment"
BR2_LINUX_KERNEL_IMAGE_TARGET_CUSTOM=y
BR2_LINUX_KERNEL_IMAGE_TARGET_NAME="Image"
BR2_TARGET_ROOTFS_CPIO=y
BR2_TARGET_ROOTFS_CPIO_GZIP=y
BR2_TARGET_ROOTFS_EXT2=y
BR2_TARGET_ROOTFS_EXT2_4=y
BR2_TARGET_ROOTFS_EXT2_SIZE="64M"
BR2_PACKAGE_LEFTOVERS_GUEST_SUPERVISOR=y
```

## vm/guest/package/leftovers-guest-supervisor/Config.in
```kconfig
config BR2_PACKAGE_LEFTOVERS_GUEST_SUPERVISOR
	bool "leftovers guest supervisor"
	depends on BR2_aarch64
	help
	  Minimal PID 1 supervisor for the Leftovers strict-VM guest.  It is
	  intentionally fail-closed and does not provide a general command runner.
```
